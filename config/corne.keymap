// Copyright 2021 Manna Harbour
// https://github.com/manna-harbour/miryoku

#include "../miryoku/custom_config.h"
#include "../miryoku/mapping/42/corne.h"
#include "../miryoku/miryoku.dtsi"

/ {
    macros {
        macro_eurkey: macro_eurkey {
                compatible = "zmk,behavior-macro-one-param";
                wait-ms = <40>;
                tap-ms = <40>;
                #binding-cells = <1>;
                bindings =
                    <&macro_press &kp LSHFT>,       /* Press Left Shift */
                    <&macro_press &kp RALT>,        /* Press Right Alt */
                    <&macro_tap   &kp N6>,          /* Tap key '6' */
                    <&macro_release &kp RALT>,      /* Release Right Alt */
                    <&macro_release &kp LSHFT>,     /* Release Left Shift */
                    <&macro_param_1to1>,            /* Forward the macro parameter */
                    <&kp MACRO_PLACEHOLDER>;        /* Placeholder to be replaced at runtime */
              };
    };
};
